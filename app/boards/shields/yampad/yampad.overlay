/*
 * Copyright (c) 2020 The ZMK Contributors
 *
 * SPDX-License-Identifier: MIT
 */

#include "yampad.dtsi"

/ {
	chosen {
		zmk,kscan = &kscan0;
	};


	kscan0: kscan {
		col-gpios
			= <&pro_micro_d 15 GPIO_ACTIVE_HIGH>
			, <&pro_micro_d 14 GPIO_ACTIVE_HIGH>
			, <&pro_micro_d 16 GPIO_ACTIVE_HIGH>
			, <&pro_micro_d 10 GPIO_ACTIVE_HIGH>
			;
	};

	// TODO: per-key RGB node(s)?
};